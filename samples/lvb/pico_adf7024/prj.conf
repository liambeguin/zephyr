## CMakeLists.txt
```
# Copyright (c) 2024 Liam Beguin <liambeguin@gmail.com>
# SPDX-License-Identifier: Apache-2.0

cmake_minimum_required(VERSION 3.20.0)
set(BOARD rpi_pico)

list(APPEND CONF_FILE "prj.conf")
# list(APPEND CONF_FILE "usb-cdc-acm.conf")

find_package(Zephyr)

project(pico_adf7024)
target_sources(app PRIVATE
	src/main.c
)
```

## prj.conf
```kconfig
# Copyright (c) 2024 Liam Beguin <liambeguin@gmail.com>
# SPDX-License-Identifier: Apache-2.0

CONFIG_EARLY_CONSOLE=y
CONFIG_LOG=y

CONFIG_SHELL=y
CONFIG_SHELL_HISTORY=y
CONFIG_GPIO_SHELL=y

CONFIG_SPI=y
CONFIG_SPI_SHELL=y

CONFIG_NETWORKING=y
CONFIG_NET_SHELL=y
CONFIG_NET_STATISTICS=y
CONFIG_NET_IPV6=n
CONFIG_NET_6LO=n

CONFIG_IEEE802154=y
CONFIG_IEEE802154_ADF702X=y

CONFIG_NSP=y
CONFIG_NSP_PACKET_LISTENER=y
CONFIG_NSP_SIMPLE_EP=n
CONFIG_NET_L2_NSP=y
CONFIG_NSP_SOCK_TX_MASK=0x20

CONFIG_LOG_PROCESS_TRIGGER_THRESHOLD=1
CONFIG_LOG_BUFFER_SIZE=4096
CONFIG_IEEE802154_DRIVER_LOG_LEVEL_INF=y



# debug
CONFIG_COMPILER_SAVE_TEMPS=y
CONFIG_THREAD_NAME=y
CONFIG_DEBUG_OPTIMIZATIONS=n
CONFIG_DEBUG_THREAD_INFO=y


# CDC-ACM
# Enable USB stack
CONFIG_USB_CDC_ACM=y
CONFIG_USB_DEVICE_STACK=y

# Enable USB Initialize at boot
CONFIG_USB_DEVICE_INITIALIZE_AT_BOOT=y

# USB device descriptors
CONFIG_USB_DEVICE_VID=0x2e8a
CONFIG_USB_DEVICE_PID=0x000a
CONFIG_USB_DEVICE_PRODUCT="Pico"
CONFIG_USB_DEVICE_MANUFACTURER="Raspberry Pi"
```

## app.overlay
```dts
/*
 * Copyright (c) 2024 Liam Beguin <liambeguin@gmail.com>
 *
 * SPDX-License-Identifier: Apache-2.0
 */
/ {
};
```

## src/main.c
```c
/*
 * Copyright (c) 2024 Liam Beguin <liambeguin@gmail.com>
 *
 * SPDX-License-Identifier: Apache-2.0
 */

#include <stdio.h>
#include <stdlib.h>
#include <zephyr/drivers/gpio.h>
#include <zephyr/kernel.h>
#include <zephyr/logging/log.h>

LOG_MODULE_REGISTER(main, LOG_LEVEL_DBG);

/* Misc devices */
static const struct gpio_dt_spec led = GPIO_DT_SPEC_GET(DT_ALIAS(led0), gpios);

static int init_led(void)
{
	int flags = 0;

	if (!gpio_is_ready_dt(&led)) {
		return -ENODEV;
	}

	flags |= GPIO_OUTPUT | GPIO_OUTPUT_INIT_LOGICAL | GPIO_OUTPUT_INIT_HIGH;
	return gpio_pin_configure_dt(&led, flags);
}

int main(void)
{
	int ret = 0;

	ret = init_led();

	return ret;
}
```
