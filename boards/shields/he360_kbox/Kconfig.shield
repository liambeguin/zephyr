## boards/shields/he360_kbox/Kconfig.shield
```kconfig
# Copyright (c) 2024 Liam Beguin <liambeguin@gmail.com>
# SPDX-License-Identifier: Apache-2.0

config SHIELD_HE360_KBOX
	def_bool $(shields_list_contains,he360_kbox)
	# select I2C
	# select GPIO_PCA95XX

if SHIELD_HE360_KBOX
	config SHELL_PROMPT_UART
		default "he360-kbox:~$ "

endif # SHIELD_HE360_KBOX
```

## boards/shields/he360_kludge/Kconfig.shield
```kconfig
# Copyright (c) 2024 Liam Beguin <liambeguin@gmail.com>
# SPDX-License-Identifier: Apache-2.0

config SHIELD_HE360_KLUDGE
	def_bool $(shields_list_contains,he360_kludge)

if SHIELD_HE360_KLUDGE
	config SHELL_PROMPT_UART
		default "he360-kludge:~$ "
endif # SHIELD_HE360_KLUDGE
```

## drivers/ieee802154/Kconfig.adf702x
```kconfig
# ADI ADF702X configuration options
# Copyright (c) 2024 HawkEye 360
# SPDX-License-Identifier: Apache-2.0

menuconfig IEEE802154_ADF702X
	bool "ADI ADF702X Driver support"
	default y
	select SPI
	select GPIO

if IEEE802154_ADF702X

config IEEE802154_ADF702X_RX_STACK_SIZE
	int "Driver's internal RX thread stack size"
	default 800
	help
	  This option sets the driver's stack size for its internal RX thread.
	  The default value should be sufficient, but in case it proves to be
	  a too little one, this option makes it easy to play with the size.

config IEEE802154_ADF702X_INIT_PRIO
	int "ADF702X initialization priority"
	default 80
	help
	  Set the initialization priority number. Do not mess with it unless
	  you know what you are doing. Beware adf702x requires gpio and spi to
	  be ready first (and sometime gpio should be the very first as spi
	  might need it too). And of course it has to start before the net stack.

config IEEE802154_ADF702X_SHELL
	bool "ADF702X debug shell"
	default y
	select POSIX_API
	select NET_SOCKETS
	select NET_SOCKETS_PACKET
	help
	  Enable ADF702x shell commands, useful during debugging to send raw
	  messages, and read statuses.
endif
```

## dts/bindings/gpio/nxp,pca9506.yaml
```yaml
# Copyright 2024 Liam Beguin
# SPDX-License-Identifier: Apache-2.0
description: NXP PCA9506 I2C GPIO expander node
compatible: nxp,pca9506
include: nxp,pca_series.yaml

properties:
  ngpios:
    required: true
    const: 40
```

## dts/bindings/ieee802154/adi,adf702x.yaml
```yaml
# Copyright (c) 2024 HawkEye 360
# SPDX-License-Identifier: Apache-2.0

description: ADI ADF702X 802.15.4 wireless transceiver

compatible: "adi,adf702x"

include: spi-device.yaml

properties:
  irq-gpios:
    type: phandle-array

  channel-frequency:
    type: int
    default: 896000000
    description: |
      Default channel frequency to use for the transceiver.

  adf7024,radio-profile:
    type: int
    default: 0
    description: |
      Default radio profile for the ADF7024

  adf702x,pa-level:
    type: string
    default: "13.5"
    description: |
      Power Amplifier (PA) level in dBm [-15; 13.5]

  adf702x,ext-pa-en:
    type: boolean
    description: |
      1:
        external PA enable signal on ATB3 is enabled. The signal is logic high
        while the ADF7023 is in the PHY_TX state and logic low while in any
        other nonsleep state.
      0:
        external PA enable signal on ADCIN_ATB3 is disabled.

  adf702x,sport-mode:
    type: int
    default: 0
    description: |
      0: Packet mode enabled.
      1: |
        Sport mode enabled. GP4 interrupt enabled on preamble detection.
        Rx data enabled on preamble detection.
      2: |
        Sport mode enabled. GP4 interrupt enabled on sync word detection.
        Rx data enabled on preamble detection.
```

## subsys/net/l2/nsp/Kconfig
```kconfig
menuconfig NET_L2_NSP
	bool "Custom NSP L2 layer over radio interface"
	help
	  Add support for stripped down WPAN IEEE 802.15.4.

if NET_L2_NSP

endif
```

## subsys/net/lib/nsp/Kconfig
```kconfig
config NSP
	bool "Socket NSP Library Support"
	select NET_SOCKETS
	select ZBUS
	select ZBUS_MSG_SUBSCRIBER
	help
	  Enable the Zephyr NSP Library


if NSP

module=NSP
module-str=Log level for NSP
module-help=Enables NSP debug messages.
source "subsys/logging/Kconfig.template.log_config"

DT_CHOSEN_NSP_UART := nsp,uart
DT_CHOSEN_NSP_CAN := nsp,can

config NSP_PACKET_COUNT
	int "NSP packet buffer pool depth"
	default 4
	help
	  NSP packet buffer pool depth

config NSP_PACKET_LISTENER
	bool "Enable NSP packet listener"
	default y
	help
	  Enable NSP Packet Listeners, this will print a message each time a
	  packet appears on the NSP zbus input and ouptut channels.

config NSP_SIMPLE_EP
	bool "Enable NSP simple endpoint"
	default y
	help
	  Enable NSP simple endpoint demonstrator. This is used to give users
	  an endpoint to start with and use as a reference.

config NSP_SHELL
	bool "NSP Shell"
	default y
	help
	  Enable the NSP shell to easily interact with NSP endpoints

config NSP_FORWARDER
	bool "NSP Forwarder"
	default y
	help
	  Enable the NSP forwarder to send packets to another interface when
	  applicable

if NSP_FORWARDER
config NSP_BACKEND_LOCAL_TX_MASK
	hex "NSP mask for local packets"
	default 0xff
	help
	  NSP mask for local packets.
	  Used to not route packets meant to be processed locally
endif

# config NSP_BACKEND_SOCK
config NSP_BACKEND_SOCK_TX_MASK
	hex "NSP tx mask for socket backend"
	default 0xff
	help
	  NSP tx mask for socket backend.
	  Used to route packets to the correct interface

config NSP_BACKEND_UART
	bool "NSP UART support"
	select CRC
	default y if $(dt_chosen_enabled,$(DT_CHOSEN_NSP_UART))
	help
	  Enable NSP support over UART

if NSP_BACKEND_UART
config NSP_BACKEND_UART_TX_MASK
	hex "NSP tx mask for UART backend"
	default 0xff
	help
	  NSP tx mask for UART backend.
	  Used to route packets to the correct interface
endif

config NSP_BACKEND_CAN
	bool "NSP CAN support"
	select CRC
	default y if $(dt_chosen_enabled,$(DT_CHOSEN_NSP_CAN))
	help
	  Enable NSP support over CAN

if NSP_BACKEND_CAN
config NSP_BACKEND_CAN_TX_MASK
	hex "NSP tx mask for CAN backend"
	default 0xff
	help
	  NSP tx mask for CAN backend.
	  Used to route packets to the correct interface
endif


if NSP_SHELL

config NSP_SHELL_SRC_ADDR
	hex "NSP source address for the shell application"
	default 0x10
	help
	  Default shell endpoint source address

config NSP_SHELL_TIMEOUT_SECONDS
	int "NSP shell timeout value in seconds"
	default 1
	help
	  NSP shell timeout value in seconds. Any shell command will wait this
	  many seconds to acquire a lock before proceeding.

endif # CONFIG_NSP_SHELL


if NSP_SIMPLE_EP

config NSP_SIMPLE_EP_ADDR
	hex "NSP address for the simple endpoint application"
	default 0x20
	help
	  Default endpoint destination address for the simple ep app

endif # NSP_SIMPLE_EP

endif # CONFIG_NSP
```
